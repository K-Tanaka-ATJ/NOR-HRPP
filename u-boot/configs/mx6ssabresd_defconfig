## u-boot/configs/mx6ssabresd_defconfig
```kconfig
CONFIG_ARM=y
CONFIG_TARGET_MX6SABRESD=y
CONFIG_SYS_EXTRA_OPTIONS="IMX_CONFIG=board/boundary/nitrogen6x/nitrogen6s.cfg,MX6S,DDR_MB=256"
# CONFIG_CMD_IMLS is not set
CONFIG_CMD_FLASH=y
CONFIG_SPI_FLASH=y
```
